## samples/subsys/greybus/uart/boards/esp32c6_devkitc.conf
```kconfig
CONFIG_GREYBUS_XPORT_UART_DEV="UART0"

CONFIG_GPIO=y
CONFIG_GPIO_ESP32=y
CONFIG_GREYBUS_GPIO=y
```

## west.yml
```yaml
manifest:
  self:
    path: greybus
  remotes:
    - name: zephyrproject-rtos
      url-base: https://github.com/zephyrproject-rtos
    - name: zephyrproject-cfriedt
      url-base: https://github.com/cfriedt
    - name: beagle-gsoc
      url-base: https://openbeagle.org/gsoc/greybus/
  projects:
    - name: zephyr
      remote: zephyrproject-rtos
      revision: 7fa8bf17563bc57d37605a724da61786f7759c28
      # remote: beagle-sdk
      # revision: sdk
      # remote: zephyrproject-cfriedt
      # revision: main
      import: true
    # - name: hal_nordic
    #   remote: zephyrproject-rtos
    #   revision: 2dbb2ed6cf461062bbac59a65b6e9d4576656350
    #   path: zephyr/modules/hal/nordic
    # - name: hal_espressif
    #   remote: zephyrproject-rtos
    #   revision: 8d35aa7075253ad0a9edd972590f224f1ab919ac
    #   path: zephyr/modules/hal/espressif
    # - name: nrf_hw_models
    #   remote: zephyrproject-rtos
    #   revision: main
    #   path: zephyr/modules/bsim_hw_models/nrf_hw_models
    # - name: cc1352-firmware
    #   remote: beagle-gsoc
    #   revision: main
    #   import: false
```
